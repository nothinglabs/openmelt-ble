## firmware/build/Kconfig/Kconfig.modules
```kconfig
menu "nrf (C:/Users/rich/ncs/v2.0.2/nrf)"
osource "C:/Users/rich/ncs/v2.0.2/nrf/Kconfig.nrf"
config ZEPHYR_NRF_MODULE
	bool
	default y
endmenu
menu "mcuboot (C:/Users/rich/ncs/v2.0.2/bootloader/mcuboot)"
osource "$(ZEPHYR_MCUBOOT_KCONFIG)"
config ZEPHYR_MCUBOOT_MODULE
	bool
	default y
endmenu
menu "mbedtls (C:/Users/rich/ncs/v2.0.2/modules/crypto/mbedtls)"
osource "$(ZEPHYR_MBEDTLS_KCONFIG)"
config ZEPHYR_MBEDTLS_MODULE
	bool
	default y
endmenu
menu "trusted-firmware-m (C:/Users/rich/ncs/v2.0.2/modules/tee/tf-m/trusted-firmware-m)"
osource "$(ZEPHYR_TRUSTED_FIRMWARE_M_KCONFIG)"
config ZEPHYR_TRUSTED_FIRMWARE_M_MODULE
	bool
	default y
endmenu
menu "cjson (C:/Users/rich/ncs/v2.0.2/modules/lib/cjson)"
osource "$(ZEPHYR_CJSON_KCONFIG)"
config ZEPHYR_CJSON_MODULE
	bool
	default y
endmenu
menu "zcbor (C:/Users/rich/ncs/v2.0.2/modules/lib/zcbor)"
osource "$(ZEPHYR_ZCBOR_KCONFIG)"
config ZEPHYR_ZCBOR_MODULE
	bool
	default y
endmenu
menu "memfault-firmware-sdk (C:/Users/rich/ncs/v2.0.2/modules/lib/memfault-firmware-sdk)"
osource "C:/Users/rich/ncs/v2.0.2/modules/lib/memfault-firmware-sdk/ports/zephyr/Kconfig"
config ZEPHYR_MEMFAULT_FIRMWARE_SDK_MODULE
	bool
	default y
endmenu
menu "canopennode (C:/Users/rich/ncs/v2.0.2/modules/lib/canopennode)"
osource "$(ZEPHYR_CANOPENNODE_KCONFIG)"
config ZEPHYR_CANOPENNODE_MODULE
	bool
	default y
endmenu
menu "chre (C:/Users/rich/ncs/v2.0.2/modules/lib/chre)"
osource "C:/Users/rich/ncs/v2.0.2/modules/lib/chre/platform/zephyr/Kconfig"
config ZEPHYR_CHRE_MODULE
	bool
	default y
endmenu
menu "hal_nordic (C:/Users/rich/ncs/v2.0.2/modules/hal/nordic)"
osource "$(ZEPHYR_HAL_NORDIC_KCONFIG)"
config ZEPHYR_HAL_NORDIC_MODULE
	bool
	default y
endmenu
menu "liblc3codec (C:/Users/rich/ncs/v2.0.2/modules/lib/liblc3codec)"
osource "$(ZEPHYR_LIBLC3CODEC_KCONFIG)"
config ZEPHYR_LIBLC3CODEC_MODULE
	bool
	default y
endmenu
menu "littlefs (C:/Users/rich/ncs/v2.0.2/modules/fs/littlefs)"
osource "$(ZEPHYR_LITTLEFS_KCONFIG)"
config ZEPHYR_LITTLEFS_MODULE
	bool
	default y
endmenu
menu "loramac-node (C:/Users/rich/ncs/v2.0.2/modules/lib/loramac-node)"
osource "$(ZEPHYR_LORAMAC_NODE_KCONFIG)"
config ZEPHYR_LORAMAC_NODE_MODULE
	bool
	default y
endmenu
menu "lvgl (C:/Users/rich/ncs/v2.0.2/modules/lib/gui/lvgl)"
osource "C:/Users/rich/ncs/v2.0.2/modules/lib/gui/lvgl/zephyr/Kconfig"
config ZEPHYR_LVGL_MODULE
	bool
	default y
endmenu
menu "lz4 (C:/Users/rich/ncs/v2.0.2/modules/lib/lz4)"
osource "$(ZEPHYR_LZ4_KCONFIG)"
config ZEPHYR_LZ4_MODULE
	bool
	default y
endmenu
menu "nanopb (C:/Users/rich/ncs/v2.0.2/modules/lib/nanopb)"
osource "$(ZEPHYR_NANOPB_KCONFIG)"
config ZEPHYR_NANOPB_MODULE
	bool
	default y
endmenu
menu "TraceRecorder (C:/Users/rich/ncs/v2.0.2/modules/debug/TraceRecorder)"
osource "C:/Users/rich/ncs/v2.0.2/modules/debug/TraceRecorder/kernelports/Zephyr/Kconfig"
config ZEPHYR_TRACERECORDER_MODULE
	bool
	default y
endmenu
menu "zscilib (C:/Users/rich/ncs/v2.0.2/modules/lib/zscilib)"
osource "C:/Users/rich/ncs/v2.0.2/modules/lib/zscilib/Kconfig.zscilib"
config ZEPHYR_ZSCILIB_MODULE
	bool
	default y
endmenu
menu "nrfxlib (C:/Users/rich/ncs/v2.0.2/nrfxlib)"
osource "C:/Users/rich/ncs/v2.0.2/nrfxlib/Kconfig.nrfxlib"
config ZEPHYR_NRFXLIB_MODULE
	bool
	default y
endmenu
menu "connectedhomeip (C:/Users/rich/ncs/v2.0.2/modules/lib/matter)"
osource "C:/Users/rich/ncs/v2.0.2/modules/lib/matter/config/nrfconnect/chip-module/Kconfig"
config ZEPHYR_CONNECTEDHOMEIP_MODULE
	bool
	default y
endmenu
```

## firmware/build/Kconfig/Kconfig.shield
```kconfig
osource "/Users/rich/projects/openmelt-ble/firmware/boards/shields/*/Kconfig.shield"
osource "/opt/nordic/ncs/v2.1.0/nrf/boards/shields/*/Kconfig.shield"
```

## firmware/build/Kconfig/Kconfig.shield.defconfig
```kconfig
osource "/Users/rich/projects/openmelt-ble/firmware/boards/shields/*/Kconfig.defconfig"
osource "/opt/nordic/ncs/v2.1.0/nrf/boards/shields/*/Kconfig.defconfig"
```
