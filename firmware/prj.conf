## CMakeLists.txt
```
#
# Copyright (c) 2018 Nordic Semiconductor
#
# SPDX-License-Identifier: LicenseRef-Nordic-5-Clause
#
cmake_minimum_required(VERSION 3.20.0)

set(PM_STATIC_YML_FILE
  ${CMAKE_CURRENT_SOURCE_DIR}/boards/pm_static_${BOARD}.yml
  )

find_package(Zephyr REQUIRED HINTS $ENV{ZEPHYR_BASE})
project(NONE)

# NORDIC SDK APP START
target_sources(app PRIVATE
  src/main.c
  src/analog_in.c
  src/melty_ble.c
  src/melty.c
  src/accel.c
  src/volt_monitor.c
  src/h3lis331dl_reg.c
)

# Preinitialization related to Thingy:53 DFU
target_sources_ifdef(CONFIG_BOARD_THINGY53_NRF5340_CPUAPP app PRIVATE
  boards/thingy53.c
)
target_sources_ifdef(CONFIG_BOARD_THINGY53_NRF5340_CPUAPP_NS app PRIVATE
  boards/thingy53.c
)


# NORDIC SDK APP END
zephyr_library_include_directories(.)
```

## prj.conf
```kconfig
#
# Copyright (c) 2018 Nordic Semiconductor
#
# SPDX-License-Identifier: LicenseRef-Nordic-5-Clause
#
CONFIG_NCS_SAMPLES_DEFAULTS=y

CONFIG_BT=y
CONFIG_BT_PERIPHERAL=y
CONFIG_BT_DEVICE_NAME="Melty_Bot"

CONFIG_NEWLIB_LIBC=y

CONFIG_DK_LIBRARY=y

CONFIG_SYSTEM_WORKQUEUE_STACK_SIZE=2048

CONFIG_ADC=y
CONFIG_ADC_ASYNC=y

CONFIG_I2C=y
CONFIG_I2C_NRFX=y

#CONFIG_SHELL=y
#CONFIG_I2C_SHELL=y

CONFIG_DEBUG_OPTIMIZATIONS=y
```

## src/main.c
```c
/*
 * Copyright (c) 2018 Nordic Semiconductor ASA
 *
 * SPDX-License-Identifier: LicenseRef-Nordic-5-Clause
 */

//Compiles against NRF Connect SDK 2.02

#include <zephyr/types.h>
#include <zephyr/sys/printk.h>
#include <zephyr/sys/byteorder.h>
#include <zephyr/kernel.h>
#include <zephyr/drivers/gpio.h>

#include <zephyr/bluetooth/bluetooth.h>
#include <zephyr/bluetooth/hci.h>
#include <zephyr/bluetooth/conn.h>
#include <zephyr/bluetooth/uuid.h>
#include <zephyr/bluetooth/gatt.h>

#include <zephyr/settings/settings.h>

#include <stddef.h>
#include <string.h>
#include <errno.h>
#include <soc.h>
#include <device.h>

#include "melty_ble.h"
#include "melty.h"
#include "accel.h"
#include "volt_monitor.h"

/* size of stack area used by each thread */
#define STACKSIZE 1024

/* scheduling priority used by each thread */
#define PRIORITY 7


#define DEVICE_NAME             CONFIG_BT_DEVICE_NAME
#define DEVICE_NAME_LEN         (sizeof(DEVICE_NAME) - 1)

static int is_connected = 0;

#define HEART_BEAT_CHECK_FREQ_MS 600

static const struct bt_data ad[] = {
	BT_DATA_BYTES(BT_DATA_FLAGS, (BT_LE_AD_GENERAL | BT_LE_AD_NO_BREDR)),
	BT_DATA(BT_DATA_NAME_COMPLETE, DEVICE_NAME, DEVICE_NAME_LEN),
};

static const struct bt_data sd[] = {
	BT_DATA_BYTES(BT_DATA_UUID128_ALL, BT_UUID_MELTYBLE_VAL),
};

static void connected(struct bt_conn *conn, uint8_t err)
{
	if (err) {
		printk("Connection failed (err %u)\n", err);
		return;
	}

	printk("Connected\n");

	is_connected = 1;

}

static void disconnected(struct bt_conn *conn, uint8_t reason)
{
	printk("Disconnected (reason %u)\n", reason);
	clear_melty_parameters_initialized();
	is_connected = 0;

}

#ifdef CONFIG_BT_LBS_SECURITY_ENABLED
static void security_changed(struct bt_conn *conn, bt_security_t level,
			     enum bt_security_err err)
{
	char addr[BT_ADDR_LE_STR_LEN];

	bt_addr_le_to_str(bt_conn_get_dst(conn), addr, sizeof(addr));

	if (!err) {
		printk("Security changed: %s level %u\n", addr, level);
	} else {
		printk("Security failed: %s level %u err %d\n", addr, level,
			err);
	}
}
#endif

BT_CONN_CB_DEFINE(conn_callbacks) = {
	.connected        = connected,
	.disconnected     = disconnected,
#ifdef CONFIG_BT_LBS_SECURITY_ENABLED
	.security_changed = security_changed,
#endif
};

#if defined(CONFIG_BT_LBS_SECURITY_ENABLED)
static void auth_passkey_display(struct bt_conn *conn, unsigned int passkey)
{
	char addr[BT_ADDR_LE_STR_LEN];

	bt_addr_le_to_str(bt_conn_get_dst(conn), addr, sizeof(addr));

	printk("Passkey for %s: %06u\n", addr, passkey);
}

static void auth_cancel(struct bt_conn *conn)
{
	char addr[BT_ADDR_LE_STR_LEN];

	bt_addr_le_to_str(bt_conn_get_dst(conn), addr, sizeof(addr));

	printk("Pairing cancelled: %s\n", addr);
}

static void pairing_complete(struct bt_conn *conn, bool bonded)
{
	char addr[BT_ADDR_LE_STR_LEN];

	bt_addr_le_to_str(bt_conn_get_dst(conn), addr, sizeof(addr));

	printk("Pairing completed: %s, bonded: %d\n", addr, bonded);
}

static void pairing_failed(struct bt_conn *conn, enum bt_security_err reason)
{
	char addr[BT_ADDR_LE_STR_LEN];

	bt_addr_le_to_str(bt_conn_get_dst(conn), addr, sizeof(addr));

	printk("Pairing failed conn: %s, reason %d\n", addr, reason);
}

static struct bt_conn_auth_cb conn_auth_callbacks = {
	.passkey_display = auth_passkey_display,
	.cancel = auth_cancel,
};

static struct bt_conn_auth_info_cb conn_auth_info_callbacks = {
	.pairing_complete = pairing_complete,
	.pairing_failed = pairing_failed
};
#else
static struct bt_conn_auth_cb conn_auth_callbacks;
#endif


bool check_heart_beat(void)
{
	static bool heart_beat_good = false;
	static uint8_t last_heart_beat = 0;
	static uint64_t time_at_last_check = 0;

	if (k_uptime_get() - time_at_last_check > HEART_BEAT_CHECK_FREQ_MS) {
		time_at_last_check = k_uptime_get();
		int current_heart_beat = get_heart_beat();
		//heartbeat must be a new number - and between 10 and 13 (inclusive)
		if (current_heart_beat != last_heart_beat && current_heart_beat >= 10 && current_heart_beat <= 13) {
			last_heart_beat = current_heart_beat;
			heart_beat_good = true;
		} else {
			heart_beat_good = false;
		}
	}
	
	return heart_beat_good;
}

void init_ble() {
	int err;

	if (IS_ENABLED(CONFIG_BT_LBS_SECURITY_ENABLED)) {
		err = bt_conn_auth_cb_register(&conn_auth_callbacks);
		if (err) {
			printk("Failed to register authorization callbacks.\n");
			return;
		}

		err = bt_conn_auth_info_cb_register(&conn_auth_info_callbacks);
		if (err) {
			printk("Failed to register authorization info callbacks.\n");
			return;
		}
	}

	err = bt_enable(NULL);
	if (err) {
		printk("Bluetooth init failed (err %d)\n", err);
		return;
	}

	printk("Bluetooth initialized\n");

	if (IS_ENABLED(CONFIG_SETTINGS)) {
		settings_load();
	}

	err = bt_melty_init();
	if (err) {
		printk("Failed to init LBS (err:%d)\n", err);
		return;
	}

	err = bt_le_adv_start(BT_LE_ADV_CONN, ad, ARRAY_SIZE(ad),
			      sd, ARRAY_SIZE(sd));
	if (err) {
		printk("Advertising failed to start (err %d)\n", err);
		return;
	}
	printk("Advertising successfully started\n");



}

void sample_bat_volt() {

	while(true) {
		update_battery_voltage();
		k_msleep(100);
	}
}


void sample_accel_thread() {
	init_accel();

	while(true) {
		update_accel_value();
		k_msleep(30);
	}
}

void main(void)
{

	init_ble();
	
	init_melty();

	while (1)
	{
		while (is_connected == 1 && get_melty_parameters_initialized()
		 && get_throttle() != 0 && check_heart_beat()) {
			do_melty();
		}
		
		update_melty_stats(0, get_battery_voltage());	//assures voltage is updated even if throttle at 0
		motors_safe();

		status_led_flash(is_connected);

	}

}


K_THREAD_DEFINE(sample_accel_thread0_id, STACKSIZE, sample_accel_thread, NULL, NULL, NULL,
		PRIORITY, 0, 0);

K_THREAD_DEFINE(sample_bat_volt0_id, STACKSIZE, sample_bat_volt, NULL, NULL, NULL,
		PRIORITY, 0, 0);
```

## src/accel.c
```c
#include "accel.h"

#include "h3lis331dl_reg.h"

// https://github.com/STMicroelectronics/h3lis331dl-pid/tree/d2404b332f7ba6f517b6b959e09014d429cac9ae?tab=readme-ov-file
// https://github.com/STMicroelectronics/STMems_Standard_C_drivers/tree/master/h3lis331dl_STdC/examples

#include <zephyr/types.h>
#include <zephyr/sys/printk.h>
#include <zephyr/sys/byteorder.h>
#include <zephyr/kernel.h>
#include <zephyr/drivers/gpio.h>
#include <zephyr/settings/settings.h>

#include <zephyr/drivers/i2c.h>

#include <string.h>
#include <stdio.h>
#include <stdint.h>
#include <stddef.h>
#include <math.h>

struct k_mutex accel_mutex;

#define I2C_ADDRESS 0x19

/* Private macro -------------------------------------------------------------*/
#define BOOT_TIME 5 // ms
/* Private variables ---------------------------------------------------------*/
static int16_t data_raw_acceleration[3];
static float acceleration_mg[3];
static uint8_t whoamI;
static uint8_t tx_buffer[1000];

#if DT_NODE_HAS_STATUS(DT_NODELABEL(i2c1), okay)
#define I2C_DEV_NODE DT_NODELABEL(i2c1)
#else
#error "Please set the correct I2C device"
#endif

uint32_t i2c_cfg = I2C_SPEED_SET(I2C_SPEED_STANDARD) | I2C_MODE_CONTROLLER;

const struct device *i2c_dev = DEVICE_DT_GET(I2C_DEV_NODE);

stmdev_ctx_t dev_ctx;

static float sampled_accel_value_g = 0.0f;

void update_accel_value()
{
  static float accel = 0;

  /* Read acceleration data */
  memset(data_raw_acceleration, 0x00, 3 * sizeof(int16_t));
  h3lis331dl_acceleration_raw_get(&dev_ctx, data_raw_acceleration);

  accel = h3lis331dl_from_fs200_to_mg(data_raw_acceleration[0]);
  accel = accel / 1000.0f;

  k_mutex_lock(&accel_mutex, K_FOREVER);
  if (sampled_accel_value_g == 0) sampled_accel_value_g = accel;
  
  //slight moving average smoothing on accel
  sampled_accel_value_g = sampled_accel_value_g * 0.5f + accel * .5f;
  k_mutex_unlock(&accel_mutex);
}

static float current_accel = 0.0f;

float get_accel_g()
{
  k_mutex_lock(&accel_mutex, K_FOREVER);
  current_accel = sampled_accel_value_g;
  k_mutex_unlock(&accel_mutex);
  return current_accel;
}

int32_t platform_write(void *handle, uint8_t Reg, const uint8_t *Bufp, uint16_t len)
{

  uint8_t buf[len + 1]; // Buffer to hold the register address and the data to write

  Reg |= 0x80;

  // First byte is the register address
  buf[0] = Reg;

  // Copy the data to write into the buffer, starting from the second byte
  memcpy(&buf[1], Bufp, len);

  // Perform the I2C write operation
  int ret = i2c_write(i2c_dev, buf, len + 1, I2C_ADDRESS);
  if (ret < 0)
  {
    printk("Failed to write data to register\n");
    return ret;
  }

  return 0; // Success
}

int32_t platform_read(void *handle, uint8_t Reg, uint8_t *Bufp, uint16_t len)
{

  Reg |= 0x80;

  // Write the register address
  int ret = i2c_write(i2c_dev, &Reg, 1, I2C_ADDRESS);
  if (ret < 0)
  {
    printk("Failed to write register address\n");
    return ret;
  }

  // Read from the register
  ret = i2c_read(i2c_dev, Bufp, len, I2C_ADDRESS);
  if (ret < 0)
  {
    printk("Failed to read data\n");
    return ret;
  }

  return 0; // Success
}

static void platform_delay(uint32_t ms)
{
  k_sleep(K_MSEC(ms));
}

void init_accel()
{
  k_mutex_init(&accel_mutex);

  i2c_configure(i2c_dev, i2c_cfg);

  /* Initialize mems driver interface */
  dev_ctx.write_reg = platform_write;
  dev_ctx.read_reg = platform_read;
  dev_ctx.mdelay = platform_delay;
  dev_ctx.handle = NULL;

  /* Wait sensor boot time */
  platform_delay(BOOT_TIME);

  /* Check device ID */
  h3lis331dl_device_id_get(&dev_ctx, &whoamI);

  if (whoamI != H3LIS331DL_ID)
  {
    while (1)
    {
      platform_delay(BOOT_TIME);
    }
  }

  /* Enable Block Data Update */
  h3lis331dl_block_data_update_set(&dev_ctx, PROPERTY_ENABLE);
  /* Set full scale */
  h3lis331dl_full_scale_set(&dev_ctx, H3LIS331DL_200g);
  /* Set Output Data Rate */
  h3lis331dl_data_rate_set(&dev_ctx, H3LIS331DL_ODR_5Hz);
}

void accel_data_polling(void)
{

  /* Read samples in polling mode (no int) */
  while (1)
  {

    /* Read output only if new value is available */
    h3lis331dl_reg_t reg;
    h3lis331dl_status_reg_get(&dev_ctx, &reg.status_reg);

    if (reg.status_reg.zyxda)
    {
      /* Read acceleration data */
      memset(data_raw_acceleration, 0x00, 3 * sizeof(int16_t));
      h3lis331dl_acceleration_raw_get(&dev_ctx, data_raw_acceleration);

      acceleration_mg[0] =
          h3lis331dl_from_fs200_to_mg(data_raw_acceleration[0]);
      acceleration_mg[1] =
          h3lis331dl_from_fs200_to_mg(data_raw_acceleration[1]);
      acceleration_mg[2] =
          h3lis331dl_from_fs200_to_mg(data_raw_acceleration[2]);

      sprintf((char *)tx_buffer,
              "Acceleration [mg]:%4.2f\t%4.2f\t%4.2f\r\n",
              acceleration_mg[0], acceleration_mg[1], acceleration_mg[2]);
    }
  }
}
```

## src/accel.h
```c
void accel_data_polling(void);
float get_accel_g();
void init_accel();
void update_accel_value();
```

## src/analog_in.c
```c
#include "analog_in.h"
#include <drivers/adc.h>
#include <string.h>

// Simple analog input method
// this just reads a sample then waits then returns it

// ADC Sampling Settings
// doc says that impedance of 800K == 40usec sample time

#define ADC_DEVICE_NAME		"ADC_0"
#define ADC_RESOLUTION		10
#define ADC_GAIN			ADC_GAIN_1_6
#define ADC_REFERENCE		ADC_REF_INTERNAL
#define ADC_ACQUISITION_TIME	ADC_ACQ_TIME(ADC_ACQ_TIME_MICROSECONDS, 40)
#define BUFFER_SIZE			6

static bool _IsInitialized = false;
static uint8_t _LastChannel = 250;
static int16_t m_sample_buffer[BUFFER_SIZE];

// the channel configuration with channel not yet filled in
static struct adc_channel_cfg m_1st_channel_cfg = {
	.gain             = ADC_GAIN,
	.reference        = ADC_REFERENCE,
	.acquisition_time = ADC_ACQUISITION_TIME,
	.channel_id       = 0, // gets set during init
	.differential	  = 0,
#if CONFIG_ADC_CONFIGURABLE_INPUTS
	.input_positive   = 0, // gets set during init
#endif
};

// return device* for the adc
static const struct device* getAdcDevice(void)
{
	return DEVICE_DT_GET(DT_NODELABEL(adc));
//	return device_get_binding(ADC_DEVICE_NAME);
}

// initialize the adc channel
static const struct device* init_adc(int channel)
{
	int ret;
	const struct device *adc_dev = getAdcDevice();
	if(_LastChannel != channel)
	{
		_IsInitialized = false;	
		_LastChannel = channel;
	}

	if ( adc_dev != NULL && !_IsInitialized)
	{
		// strangely channel_id gets the channel id and input_positive gets id+1
		m_1st_channel_cfg.channel_id = channel;
#if CONFIG_ADC_CONFIGURABLE_INPUTS
        m_1st_channel_cfg.input_positive = channel+1,
#endif
		ret = adc_channel_setup(adc_dev, &m_1st_channel_cfg);
		if(ret != 0)
		{
			//LOG_INF("Setting up of the first channel failed with code %d", ret);
			adc_dev = NULL;
		}
		else
		{
			_IsInitialized = true;	// we don't have any other analog users
		}
	}
	
	memset(m_sample_buffer, 0, sizeof(m_sample_buffer));
	return adc_dev;
}

// ------------------------------------------------
// read one channel of adc
// ------------------------------------------------
static int16_t readOneChannel(int channel)
{
	const struct adc_sequence sequence = {
		.options     = NULL,				// extra samples and callback
		.channels    = BIT(channel),		// bit mask of channels to read
		.buffer      = m_sample_buffer,		// where to put samples read
		.buffer_size = sizeof(m_sample_buffer),
		.resolution  = ADC_RESOLUTION,		// desired resolution
		.oversampling = 0,					// don't oversample
		.calibrate = 0						// don't calibrate
	};

	int ret;
	int16_t sample_value = BAD_ANALOG_READ;
	const struct device *adc_dev = init_adc(channel);
	if (adc_dev)
	{
		ret = adc_read(adc_dev, &sequence);
		if(ret == 0)
		{
			sample_value = m_sample_buffer[0];
		}
	}

	return sample_value;
}

// ------------------------------------------------
// high level read adc channel and convert to float voltage
// ------------------------------------------------
float AnalogRead(int channel)
{

	int16_t sv = readOneChannel(channel);
	if(sv == BAD_ANALOG_READ)
	{
		return sv;
	}

	// Convert the result to voltage
	// Result = [V(p) - V(n)] * GAIN/REFERENCE / 2^(RESOLUTION)
																				  
	int multip = 256;
	// find 2**adc_resolution
	switch(ADC_RESOLUTION)
				
	{
		default :
		case 8 :
			multip = 256;
			break;
		case 10 :
			multip = 1024;
			break;
		case 12 :
			multip = 4096;
			break;
		case 14 :
			multip = 16384;
			break;
	}
	
	// the 3.6 relates to the voltage divider being used in my circuit
	float fout = (sv * 3.6 / multip);
	return fout;
}
```

## src/melty.c
```c
#include <zephyr/types.h>
#include <zephyr/sys/printk.h>
#include <zephyr/sys/byteorder.h>
#include <zephyr/kernel.h>
#include <zephyr/drivers/gpio.h>
#include <zephyr/settings/settings.h>

#include <stddef.h>
#include <string.h>
#include <errno.h>
#include <soc.h>
#include <device.h>
#include <math.h>

#include "melty.h"
#include "melty_ble.h"
#include "analog_in.h"
#include "accel.h"
#include "volt_monitor.h"

#define MELTY_LED_PIN			13
#define MOTOR_PIN1				4
#define MOTOR_PIN2				3

#define ZERO_G_OFFSET_SAMPLES	30


//full power spin in below this number
#define MIN_TRANSLATION_RPM                    250
#define MAX_TRANSLATION_ROTATION_INTERVAL_US   (1.0f / MIN_TRANSLATION_RPM) * 60 * 1000 * 1000

//don't even try to do heading track if we are this slow
//limits max time spent in do_melty (helps assure heartbeat is checked at safe interval)
#define MAX_TRACKING_ROTATION_INTERVAL_US   MAX_TRANSLATION_ROTATION_INTERVAL_US * 2


static const struct device *dev;

static float zero_g_accel;


void init_melty(void){

	dev = DEVICE_DT_GET(DT_NODELABEL(gpio0));

	gpio_pin_configure(dev, MELTY_LED_PIN, GPIO_OUTPUT); 
	gpio_pin_configure(dev, MOTOR_PIN1, GPIO_OUTPUT); 
	gpio_pin_configure(dev, MOTOR_PIN2, GPIO_OUTPUT); 

	for (int x = 0; x < ZERO_G_OFFSET_SAMPLES; x++) {
		zero_g_accel += get_accel_g();
	}
	zero_g_accel = zero_g_accel / ZERO_G_OFFSET_SAMPLES;

}

void motors_safe(void) {
    //motor off!
	gpio_pin_set(dev, MOTOR_PIN1, 0);
	gpio_pin_set(dev, MOTOR_PIN2, 0);
}


static float get_rotation_interval_ms(void){

	//increasing causes tracking speed to decrease
	float radius_in_cm = get_radius();

 	//calculate RPM from g's - derived from "G = 0.00001118 * r * RPM^2"
	float rpm;
	rpm = get_accel_g() * 89445.0f;                               
	rpm = rpm / radius_in_cm;
	rpm = sqrt(rpm);	

	float rotation_interval = (1.0f / rpm) * 60 * 1000;
	if (rotation_interval > 250) rotation_interval = 250;
	if (rotation_interval < 0) rotation_interval = 250;
	return rotation_interval;
}



static struct melty_parameters_t get_melty_parameters(void) {

	float led_offset_portion = get_led_offset() / 100.0f;
	float motor_on_portion = get_throttle() / 100.0f;	
	float led_on_portion = .4f * (1.1f - motor_on_portion);     //LED width changed with throttle

	struct melty_parameters_t melty_parameters;
	melty_parameters.rotation_interval_us = get_rotation_interval_ms() * 1000;

	//if under defined RPM - just try to spin up
    if (melty_parameters.rotation_interval_us > MAX_TRANSLATION_ROTATION_INTERVAL_US) motor_on_portion = 1;

    //if we are too slow - don't even try to track heading
	if (melty_parameters.rotation_interval_us > MAX_TRACKING_ROTATION_INTERVAL_US) {
        melty_parameters.rotation_interval_us = MAX_TRACKING_ROTATION_INTERVAL_US;
    }

	u_int32_t motor_on_us = motor_on_portion * melty_parameters.rotation_interval_us;
	
    u_int32_t led_on_us = led_on_portion * melty_parameters.rotation_interval_us;
	u_int32_t led_offset_us = led_offset_portion * melty_parameters.rotation_interval_us;

    //center LED on offset
	if (led_on_us / 2 <= led_offset_us) {
        melty_parameters.led_start = led_offset_us - (led_on_us / 2);
    } else {
       melty_parameters.led_start =  (melty_parameters.rotation_interval_us + led_offset_us) - (led_on_us / 2); 
    }

 	melty_parameters.led_stop = melty_parameters.led_start + led_on_us;
	
	if (melty_parameters.led_stop > melty_parameters.rotation_interval_us)
		melty_parameters.led_stop = melty_parameters.led_stop - melty_parameters.rotation_interval_us;

	melty_parameters.motor_start1 = (melty_parameters.rotation_interval_us - motor_on_us) / 2;
	melty_parameters.motor_stop1 = melty_parameters.motor_start1 + motor_on_us;

	melty_parameters.motor_start2 = melty_parameters.rotation_interval_us - (motor_on_us / 2);
	melty_parameters.motor_stop2 = motor_on_us / 2;

	return melty_parameters;

}

void update_melty_stats(int rotation_interval_ms, float battery_voltage) {
	u_int8_t melty_stats[3] = {0, 0, 0};
	melty_stats[0] = rotation_interval_ms;
	melty_stats[2] = battery_voltage * 10.0f;
	bt_send_melty_stats(melty_stats);
}

void do_melty(void){
		
	u_int32_t time_spent_this_rotation_us = 0;

	int sleep_time_us = 10;

	static u_int32_t cycle_count = 0;

	/* capture initial time stamp */
	u_int32_t start_time;
	start_time = k_cycle_get_32();

	struct melty_parameters_t melty_parameters = get_melty_parameters();

	update_melty_stats(melty_parameters.rotation_interval_us / 1000, get_battery_voltage());

	cycle_count++;

	while(time_spent_this_rotation_us < melty_parameters.rotation_interval_us) {
		u_int32_t stop_time;
		int64_t cycles_spent;

        melty_parameters = get_melty_parameters();

		//assures BLE gets time to do it's thing
		k_sleep(K_USEC(sleep_time_us));

		if (get_translate_direction() == TRANSLATE_FORWARD || (get_translate_direction() == TRANSLATE_IDLE && cycle_count % 2 == 0)) {
			if (time_spent_this_rotation_us >= melty_parameters.motor_start1 && 
				time_spent_this_rotation_us <= melty_parameters.motor_stop1) {
					gpio_pin_set(dev, MOTOR_PIN1, 1);
			} else {
					gpio_pin_set(dev, MOTOR_PIN1, 0);
			}

			if (time_spent_this_rotation_us >= melty_parameters.motor_start2 || 
				time_spent_this_rotation_us <= melty_parameters.motor_stop2) {
					gpio_pin_set(dev, MOTOR_PIN2, 1);
			} else {
					gpio_pin_set(dev, MOTOR_PIN2, 0);
			}

		}

		if (get_translate_direction() == TRANSLATE_REVERSE || (get_translate_direction() == TRANSLATE_IDLE && cycle_count %2 == 1)) {
			if (time_spent_this_rotation_us >= melty_parameters.motor_start2 || 
				time_spent_this_rotation_us <= melty_parameters.motor_stop2) {
					gpio_pin_set(dev, MOTOR_PIN1, 1);
			} else {
					gpio_pin_set(dev, MOTOR_PIN1, 0);
			}

		if (time_spent_this_rotation_us >= melty_parameters.motor_start1 && 
				time_spent_this_rotation_us <= melty_parameters.motor_stop1) {
					gpio_pin_set(dev, MOTOR_PIN2, 1);
			} else {
					gpio_pin_set(dev, MOTOR_PIN2, 0);
			}

		}
		
		if (melty_parameters.led_start > melty_parameters.led_stop) {
    		if (time_spent_this_rotation_us >= melty_parameters.led_start || time_spent_this_rotation_us <= melty_parameters.led_stop) {
				gpio_pin_set(dev, MELTY_LED_PIN, 1);
			} else {
				gpio_pin_set(dev, MELTY_LED_PIN, 0);
			}
		} else {
			if (time_spent_this_rotation_us >= melty_parameters.led_start && time_spent_this_rotation_us <= melty_parameters.led_stop) {
				gpio_pin_set(dev, MELTY_LED_PIN, 1);
			} else {
				gpio_pin_set(dev, MELTY_LED_PIN, 0);
			}
		}
		
		/* capture final time stamp */
		stop_time = k_cycle_get_32();

		cycles_spent = stop_time - start_time;
		if (cycles_spent < 0) cycles_spent = cycles_spent + UINT32_MAX;
		time_spent_this_rotation_us += SYS_CLOCK_HW_CYCLES_TO_NS_AVG(cycles_spent, 1) / 1000;
		start_time = k_cycle_get_32();
	}

}

void status_led_flash(int connected) {

	gpio_pin_set(dev, MELTY_LED_PIN, 0);
	
    //do accel dependent flash if not connected (provides easy way to verify accelerometer is working)
	//fast flash if connected
    if (connected == 0) {
        k_sleep(K_MSEC(200));
        int on_time = 1 + (int)(get_accel_g() * 50.0f);

        if (on_time > 0) {
            gpio_pin_set(dev, MELTY_LED_PIN, 1);
            k_sleep(K_MSEC(on_time));
        }
    } else {
        k_sleep(K_MSEC(50));
        gpio_pin_set(dev, MELTY_LED_PIN, 1);
        k_sleep(K_MSEC(50));
    }

}
```

## src/melty.h
```c
#ifndef MELTY_CONTROL_H_

#define MELTY_CONTROL_H_

void do_melty(void);
void init_melty(void);
void motors_safe(void);
void status_led_flash(int connected);

void update_melty_stats(int rotation_interval_ms, float battery_voltage);

typedef struct melty_parameters_t {
	u_int32_t rotation_interval_us;
	u_int32_t led_start;
	u_int32_t led_stop;
	u_int32_t motor_start1;
	u_int32_t motor_stop1;
	u_int32_t motor_start2;
	u_int32_t motor_stop2;
};

#endif
```

## src/melty_ble.c
```c
/*
 * Copyright (c) 2018 Nordic Semiconductor ASA
 *
 * SPDX-License-Identifier: LicenseRef-Nordic-5-Clause
 */

/** @file
 *  @brief Melty Brain BLE control interface
 */

#include <zephyr/types.h>
#include <stddef.h>
#include <string.h>
#include <errno.h>
#include <zephyr/sys/printk.h>
#include <zephyr/sys/byteorder.h>
#include <zephyr/kernel.h>

#include <zephyr/bluetooth/bluetooth.h>
#include <zephyr/bluetooth/hci.h>
#include <zephyr/bluetooth/conn.h>
#include <zephyr/bluetooth/uuid.h>
#include <zephyr/bluetooth/gatt.h>

#include <zephyr/logging/log.h>

#include "melty_ble.h"

LOG_MODULE_REGISTER(bt_meltble, 3);

static bool                   notify_enabled;

static bool melty_parameters_initialized = false;

static float radius;
static u_int8_t led_offset;
static u_int8_t throttle;
static u_int8_t translate_direction;
static u_int8_t heart_beat;

static void melty_ccc_cfg_changed(const struct bt_gatt_attr *attr,
				  uint16_t value)
{
	notify_enabled = (value == BT_GATT_CCC_NOTIFY);
}

static ssize_t update_melty_config(struct bt_conn *conn,
			 const struct bt_gatt_attr *attr,
			 const void *buf,
			 uint16_t len, uint16_t offset, uint8_t flags)
{
	LOG_DBG("Attribute write, handle: %u, conn: %p", attr->handle,
		(void *)conn);

	if (len != 7U) {
		LOG_DBG("Write led: Incorrect data length");
		return BT_GATT_ERR(BT_ATT_ERR_INVALID_ATTRIBUTE_LEN);
	}

	if (offset != 0) {
		LOG_DBG("Write led: Incorrect data offset");
		return BT_GATT_ERR(BT_ATT_ERR_INVALID_OFFSET);
	}

    melty_parameters_initialized = false;

    radius = (((uint8_t *)buf)[0] + ((uint8_t *)buf)[1] * 256) / 1000.0f;
    led_offset = ((uint8_t *)buf)[2];
    throttle = ((uint8_t *)buf)[3];
    translate_direction = ((int8_t *)buf)[4];
    heart_beat = ((int8_t *)buf)[5];
    //byte 6 reserved

    melty_parameters_initialized = true;
    LOG_DBG("params updated");

	return len;
}

void clear_melty_parameters_initialized(void) {
    melty_parameters_initialized = false;
}

bool get_melty_parameters_initialized(void) {
    return melty_parameters_initialized;
}

float get_radius(void) {
    return radius;
}


u_int8_t get_heart_beat(void) {
    return heart_beat;
}

u_int8_t get_translate_direction(void) {
    return translate_direction;
}

u_int8_t get_throttle(void) {
    return throttle;
}

u_int8_t get_led_offset(void) {
    return led_offset;
}


/* MeltyBLE Service Declaration */
BT_GATT_SERVICE_DEFINE(meltyble_svc,
BT_GATT_PRIMARY_SERVICE(BT_UUID_MELTYBLE),
	BT_GATT_CHARACTERISTIC(BT_UUID_MELTYBLE_STATS,
			       BT_GATT_CHRC_READ | BT_GATT_CHRC_NOTIFY,
			       BT_GATT_PERM_READ, NULL, NULL, NULL),
	BT_GATT_CCC(melty_ccc_cfg_changed,
		    BT_GATT_PERM_READ | BT_GATT_PERM_WRITE),
	BT_GATT_CHARACTERISTIC(BT_UUID_MELTYBLE_CONFIG,
			       BT_GATT_CHRC_WRITE,
			       BT_GATT_PERM_WRITE,
			       NULL, update_melty_config, NULL),
);

int bt_melty_init(void)
{
	//nothing to init / placeholder
	return 0;
}

int bt_send_melty_stats(u_int8_t melty_stats[3])
{
	if (!notify_enabled) {
		return -EACCES;
	}

	return bt_gatt_notify(NULL, &meltyble_svc.attrs[2],
			      melty_stats,
			      3);
}
```

## src/melty_ble.h
```c
/*
 * Copyright (c) 2018 Nordic Semiconductor ASA
 *
 * SPDX-License-Identifier: LicenseRef-Nordic-5-Clause
 */

#ifndef MELTY_BLE_H_
#define MELTY_BLE_H_

#ifdef __cplusplus
extern "C" {
#endif

#include <zephyr/types.h>

/** @brief MELTYBLE Service UUID. */
#define BT_UUID_MELTYBLE_VAL \
	BT_UUID_128_ENCODE(0x00001523, 0x1212, 0xefde, 0x1523, 0x785feabcd123)

/** @brief Melty Stats Characteristic UUID. */
#define BT_UUID_MELTYBLE_STATS_VAL \
	BT_UUID_128_ENCODE(0x00001524, 0x1212, 0xefde, 0x1523, 0x785feabcd123)

//BT_UUID_MELTYBLE_STATS
//3 bytes of data sent to client to indicate RPM and battery voltage
//[0] Current rotation interval in MS (convert to RPM on client) - value of 0 should be handled as 0 RPM
//[1] Reserved
//[2] Current battery voltage * 10

/** @brief Melty Config Characteristic UUID. */
#define BT_UUID_MELTYBLE_CONFIG_VAL \
	BT_UUID_128_ENCODE(0x00001525, 0x1212, 0xefde, 0x1523, 0x785feabcd123)

//BT_UUID_MELTYBLE_CONFIG
//7 bytes of data sent from BLE client to configure melty bot
//2-byte (unsigned) radius value is provided as radius in centimeters * 1000
// Dynamic adjustment of radius is used to control steering
// [0] Radius Least Signicant Byte
// [1] Radius Most Signficant Byte
// [2] LED_offset 0-99 value corresponding to offset % LED beacon is located (adjusts heading)
// [3] Throttle 0-100 value corresponding % of each rotation wheel(s) are powered
	//0 = off, 100 = fully on (no translation)
// [4] Translate direction (idle, forward or reverse)
// [5] Heartbeat value
// [6] Reserved 

#define TRANSLATE_IDLE 0
#define TRANSLATE_FORWARD 1
#define TRANSLATE_REVERSE 2

#define BT_UUID_MELTYBLE           	BT_UUID_DECLARE_128(BT_UUID_MELTYBLE_VAL)
#define BT_UUID_MELTYBLE_STATS    	BT_UUID_DECLARE_128(BT_UUID_MELTYBLE_STATS_VAL)
#define BT_UUID_MELTYBLE_CONFIG		BT_UUID_DECLARE_128(BT_UUID_MELTYBLE_CONFIG_VAL)


int bt_melty_init(void);

int bt_send_melty_stats(u_int8_t melty_stats[3]);

float get_radius(void);

bool get_melty_parameters_initialized(void);

void clear_melty_parameters_initialized(void);

u_int8_t get_translate_direction(void);

u_int8_t get_heart_beat(void);

u_int8_t get_throttle(void);

u_int8_t get_led_offset(void);

#ifdef __cplusplus
}
#endif



#endif 
```

## src/volt_monitor.c
```c
#include <zephyr/types.h>
#include <zephyr/sys/printk.h>
#include <zephyr/sys/byteorder.h>
#include <zephyr/kernel.h>
#include <zephyr/drivers/gpio.h>
#include <zephyr/settings/settings.h>

#include <stddef.h>
#include <string.h>
#include <errno.h>
#include <soc.h>
#include <device.h>
#include <math.h>

#include "volt_monitor.h"
#include "analog_in.h"

//AIN05 = pin 29
#define BATTERY_V_ADC_CHANNEL 5	

#define BATTERY_ADC_READS 1

#define BATTERY_VOLTAGE_DIVIDER_RATIO 11.1f	//For example - 11k to V+ and to 1k to GND

static float battery_voltage = 0.0f;

struct k_mutex volt_monitor_mutex;


float adc_multi_sample(int samples, int adc_channel) {
	float multi_sample = 0;
    for (int loop = 0; loop < samples; loop ++) {
		multi_sample += AnalogRead(adc_channel);
	}
    return multi_sample / samples;
}


void update_battery_voltage(void) {
	float current_voltage = adc_multi_sample(BATTERY_ADC_READS, BATTERY_V_ADC_CHANNEL);
	
	k_mutex_lock(&volt_monitor_mutex, K_FOREVER);
	if (battery_voltage == 0) battery_voltage = current_voltage;
	battery_voltage = (battery_voltage * 0.8f) + (current_voltage * BATTERY_VOLTAGE_DIVIDER_RATIO) * .2f;
	k_mutex_unlock(&volt_monitor_mutex);
}

float get_battery_voltage(void) {
	k_mutex_lock(&volt_monitor_mutex, K_FOREVER);
	float voltage = battery_voltage;
	k_mutex_unlock(&volt_monitor_mutex);

	return voltage;
}
```

## src/volt_monitor.h
```c
#ifndef VOLT_MONITOR_H_

#define VOLT_MONITOR_H_

float get_battery_voltage(void);

void update_battery_voltage(void);

#endif
```
